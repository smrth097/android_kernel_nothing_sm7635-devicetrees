/dts-v1/;
/plugin/;

#include <dt-bindings/clock/qcom,gcc-volcano.h>
#include <dt-bindings/clock/qcom,camcc-volcano.h>
#include <dt-bindings/interconnect/qcom,volcano.h>
#include <dt-bindings/interrupt-controller/arm-gic.h>
#include <dt-bindings/regulator/qcom,rpmh-regulator-levels.h>
#include "../qcom/volcano-qrd.dtsi"
#include "frogger.dtsi"
#include "../qcom/camera/volcano-camera.dtsi"
#include "frogger-camera-sensor.dtsi"

/ {
	model = "Nothing Phone (4a)";
	qcom,msm-id = <636 0x10000>;
	qcom,board-id = <11 0>;
	qcom,oem-id = <1>;
};
